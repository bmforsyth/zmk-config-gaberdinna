## boards/shields/Kconfig.defconfig
```kconfig
if SHIELD_GABERDINNA_LEFT

config ZMK_KEYBOARD_NAME
	default "Gaberdinna"

config ZMK_SPLIT_ROLE_CENTRAL
	default y

endif

if SHIELD_GABERDINNA_LEFT || SHIELD_GABERDINNA_RIGHT

config ZMK_SPLIT
	default y

endif
```

## config/boards/shields/gaberdinna/Kconfig.shield
```kconfig
config SHIELD_GABERDINNA_LEFT
    def_bool $(shields_list_contains,gaberdinna_left)

config SHIELD_GABERDINNA_RIGHT
    def_bool $(shields_list_contains,gaberdinna_right)
```
